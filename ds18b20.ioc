# file: ds18b20.ioc
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Mcu.Family=STM32WL
PC15-OSC32_OUT.Mode=LSE-External-Oscillator
RCC.CortexFreq_Value=16000000
VP_RTC_VS_RTC_Activate.Mode=RTC_Enabled
PC14-OSC32_IN.Signal=RCC_OSC32_IN
PA12.GPIO_Label=DSPIN
ProjectManager.StackSize=0x400
PA13.Signal=DEBUG_JTMS-SWDIO
PA12.GPIO_ModeDefaultOutputPP=GPIO_MODE_OUTPUT_OD
PA12.Signal=GPIO_Output
ProjectManager.TargetToolchain=STM32CubeIDE
RCC.HCLKFreq_Value=16000000
RCC.FLatency=FLASH_LATENCY_2
RCC.APB2TimFreq_Value=16000000
RCC.LSE_VALUE=32768
PC15-OSC32_OUT.Signal=RCC_OSC32_OUT
RCC.AHBFreq_Value=16000000
RCC.HSE_VALUE=8000000
board=custom
RCC.VCOOutputFreq_Value=128000000
RCC.RTCClockSelection=RCC_RTCCLKSOURCE_LSE
RCC.APB2Freq_Value=16000000
PC14-OSC32_IN.Mode=LSE-External-Oscillator
VP_TIM2_VS_ClockSourceINT.Mode=Internal
PA14.Mode=Serial_Wire
PA13.Mode=Serial_Wire
Mcu.Name=STM32WL55JCIx
RCC.APB3Freq_Value=16000000
RCC.SYSCLKFreq_VALUE=16000000
Mcu.Package=UFBGA73
TIM2.Prescaler=15
PA14.Signal=DEBUG_JTCK-SWCLK
ProjectManager.HeapSize=0x200
RCC.HSI_VALUE=16000000
NVIC.PriorityGroup=NVIC_PRIORITYGROUP_4
RCC.APB1TimFreq_Value=16000000
PA12.GPIO_PuPd=GPIO_NOPULL
RCC.APB1Freq_Value=16000000
RCC.MSIClockRange=RCC_MSIRANGE_8

// file: Core/Src/main.c
/* USER CODE BEGIN Header */
/**
 ******************************************************************************
 * @file           : main.c
 * @brief          : Main program body
 ******************************************************************************
 * @attention
 *
 * <h2><center>&copy; Copyright (c) 2021 STMicroelectronics.
 * All rights reserved.</center></h2>
 *
 * This software component is licensed by ST under BSD 3-Clause license,
 * the "License"; You may not use this file except in compliance with the
 * License. You may obtain a copy of the License at:
 *                        opensource.org/licenses/BSD-3-Clause
 *
 ******************************************************************************
 */
/* USER CODE END Header */
#include "main.h"
#include "rtc.h"
#include "tim.h"
#include "gpio.h"

/* USER CODE BEGIN Includes */
#include "util.h"
#include "ds18b20.h"
#include "settings.h"
/* USER CODE END Includes */

/* USER CODE BEGIN PM */
static ds18b20_cfg_t ds18b20_init_cfg[] = { { .mode = SKIP_ROM, .resolution = RESOLUTION_12BIT,
                                              .temp_high_trigger = DS_TH_REGISTER_VALUE,
                                              .temp_low_trigger = DS_TL_REGISTER_VALUE, .GPIOx = DS_ONE_WIRE_PORT,
                                              .odr_bit = DS_ONE_WIRE_ODR_BIT, .idr_bit = DS_ONE_WIRE_IDR_BIT, } };
/* USER CODE END PM */

void SystemClock_Config(void);
/* USER CODE BEGIN PFP */
#if defined(DEBUG) && defined(USING_SEMIHOSTING)
extern void initialise_monitor_handles(void);
#endif
/* USER CODE END PFP */

int main(void)
{

  /* MCU Configuration--------------------------------------------------------*/

  /* Reset of all peripherals, Initializes the Flash interface and the Systick. */

  NVIC_SetPriorityGrouping(NVIC_PRIORITYGROUP_4);

  /* System interrupt init*/

  /* Configure the system clock */
  SystemClock_Config();

  /* USER CODE BEGIN SysInit */
    LL_SYSTICK_EnableIT();
#if defined(USING_SEMIHOSTING)
    initialise_monitor_handles();
#endif
  /* USER CODE END SysInit */

  /* Initialize all configured peripherals */
  MX_GPIO_Init();
  MX_TIM2_Init();
  MX_RTC_Init();
  /* USER CODE BEGIN 2 */
    ds18b20_init(ds18b20_init_cfg);
  /* USER CODE END 2 */

  /* Infinite loop */
  /* USER CODE BEGIN WHILE */
    while (1) {
        ds18b20_loop();
    /* USER CODE END WHILE */

    }
}

void SystemClock_Config(void)
{
  LL_FLASH_SetLatency(LL_FLASH_LATENCY_2);
  while(LL_FLASH_GetLatency() != LL_FLASH_LATENCY_2)
  {
  }

  LL_PWR_SetRegulVoltageScaling(LL_PWR_REGU_VOLTAGE_SCALE2);
  LL_RCC_MSI_Enable();

   /* Wait till MSI is ready */
  while(LL_RCC_MSI_IsReady() != 1)
  {
  }

  LL_RCC_MSI_EnableRangeSelection();
  LL_RCC_MSI_SetRange(LL_RCC_MSIRANGE_8);
  LL_RCC_MSI_SetCalibTrimming(0);
  LL_PWR_EnableBkUpAccess();
  LL_RCC_LSE_SetDriveCapability(LL_RCC_LSEDRIVE_LOW);
  LL_RCC_LSE_Enable();

   /* Wait till LSE is ready */
  while(LL_RCC_LSE_IsReady() != 1)
  {
  }

  LL_RCC_MSI_EnablePLLMode();
  LL_RCC_SetSysClkSource(LL_RCC_SYS_CLKSOURCE_MSI);

   /* Wait till System clock is ready */
  while(LL_RCC_GetSysClkSource() != LL_RCC_SYS_CLKSOURCE_STATUS_MSI)
  {
  }

  LL_RCC_SetAHBPrescaler(LL_RCC_SYSCLK_DIV_1);
  LL_RCC_SetAHB3Prescaler(LL_RCC_SYSCLK_DIV_1);
  LL_RCC_SetAPB1Prescaler(LL_RCC_APB1_DIV_1);
  LL_RCC_SetAPB2Prescaler(LL_RCC_APB2_DIV_1);

  LL_Init1msTick(16000000);

  /* Update CMSIS variable (which can be updated also through SystemCoreClockUpdate function) */
  LL_SetSystemCoreClock(16000000);
}

void Error_Handler(void)
{
    __disable_irq();
    while (1) {
    }
}

/************************ (C) COPYRIGHT STMicroelectronics *****END OF FILE****/
